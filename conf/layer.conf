## conf/machine/gta04.conf
```bitbake
#@TYPE: Machine
#@NAME: GTA04
#@SOC: OMAP3
#@DESCRIPTION: Machine configuration for GTA04
#@MAINTAINER: Josua Mayer <josua.mayer@jm0.eu>

# Tune for Cortex-A8, with Thumb, VFP and Neon
DEFAULTTUNE ?= "cortexa8thf-neon"
require conf/machine/include/arm/armv7a/tune-cortexa8.inc

# define machine features per yocto reference manual:
# https://docs.yoctoproject.org/ref-manual/features.html
# TODO: SOme of them seem unused, reduce to useful minimum
MACHINE_FEATURES += "alsa bluetooth ext2 phone qemu-usermode rtc screen serial touchscreen usbgadget usbhost vfat vga wifi"

# require downstream u-boot
PREFERRED_PROVIDER_virtual/bootloader = "u-boot-gta04"
UBOOT_ARCH ?= "arm"
UBOOT_MACHINE ?= "letux_gta04_defconfig"
UBOOT_ENTRYPOINT = "0x80008000"
UBOOT_LOADADDRESS = "0x80008000"
SPL_BINARY = "MLO"
UBOOT_SUFFIX = "img"

# use downstream kernel
PREFERRED_PROVIDER_virtual/kernel = "linux-gta04"
KERNEL_IMAGETYPE = "uImage"
KEEPUIMAGE = "no"
KERNEL_DEVICETREE = " \
    ti/omap/omap3-gta04a2.dtb \
    ti/omap/omap3-gta04a3.dtb \
    ti/omap/omap3-gta04a4.dtb \
    ti/omap/omap3-gta04a5.dtb \
"

# Define bootable sdcard files
WKS_FILE = "gta04-sdcard.wks"
# copy u-boot and boot-menu to boot-partition
# TODO: MLO.flash, u-boot.img.flash
IMAGE_BOOT_FILES ?= " \
    ${SPL_BINARY} \
    u-boot.${UBOOT_SUFFIX} \
    boot.scr \
    menu.rgb16z \
    splash.rgb16z \
"
do_image_wic[depends] += "virtual/bootloader:do_deploy"

# Define image types:
# - tar.bz2: rootfs
# - wic: for bootable microSD with bootloader, boot- and rootfs partitions
# - TODO: ubifs / onenand
IMAGE_FSTYPES += "tar.bz2 wic.xz wic.bmap"

# include packages essential for boot including power-supply / charger
MACHINE_ESSENTIAL_EXTRA_RDEPENDS = " \
    kernel \
    kernel-devicetree \
    kernel-module-bq27xxx-battery \
    kernel-module-bq27xxx-battery-hdq \
    kernel-module-musb-hdrc \
    kernel-module-omap2430 \
    kernel-module-omap-hdq \
    kernel-module-phy-twl4030-usb \
    kernel-module-twl4030-charger \
    kernel-module-twl4030-madc \
    kernel-module-twl4030-pwrbutton \
    kernel-module-industrialio \
"

# extra packages supporting all integrated peripherals for fully-featured images
MACHINE_EXTRA_RDEPENDS = " \
    kernel-module-at24 \
    kernel-module-bluetooth \
    kernel-module-bmc150-accel-core \
    kernel-module-bmc150-accel-i2c \
    kernel-module-bmc150-magn \
    kernel-module-bmc150-magn-i2c \
    kernel-module-bmg160-core \
    kernel-module-bmg160-i2c \
    kernel-module-bmp280 \
    kernel-module-bmp280-i2c \
    kernel-module-bmp280-spi \
    kernel-module-bno055 \
    kernel-module-bno055-i2c \
    kernel-module-bno055-ser \
    kernel-module-btbcm \
    kernel-module-cec \
    kernel-module-cfg80211 \
    kernel-module-crypto-engine \
    kernel-module-display-connector \
    kernel-module-drm \
    kernel-module-drm-kms-helper \
    kernel-module-drm-panel-orientation-quirks \
    kernel-module-ecc \
    kernel-module-ecdh-generic \
    kernel-module-ehci-omap \
    kernel-module-gnss \
    kernel-module-gnss-sirf \
    kernel-module-hci-uart \
    kernel-module-industrialio-triggered-buffer \
    kernel-module-kfifo-buf \
    kernel-module-leds-tca6507 \
    kernel-module-libarc4 \
    kernel-module-mac80211 \
    kernel-module-mc \
    kernel-module-ohci-hcd \
    kernel-module-ohci-platform \
    kernel-module-omap3-isp \
    kernel-module-omap-aes-driver \
    kernel-module-omap-crypto \
    kernel-module-omap-sham \
    kernel-module-omapdrm \
    kernel-module-ov9655 \
    kernel-module-panel-tpo-td028ttec1 \
    kernel-module-pps-core \
    kernel-module-pps-gpio \
    kernel-module-pvrsrvkm-omap3630-sgx530-125 \
    kernel-module-pwm-bl \
    kernel-module-pwm-omap-dmtimer \
    kernel-module-simple-bridge \
    kernel-module-snd-soc-gtm601 \
    kernel-module-snd-soc-omap-mcbsp \
    kernel-module-snd-soc-omap-twl4030 \
    kernel-module-snd-soc-si47xx \
    kernel-module-snd-soc-simple-card \
    kernel-module-snd-soc-simple-card-utils \
    kernel-module-snd-soc-ti-sdma \
    kernel-module-snd-soc-twl4030 \
    kernel-module-snd-soc-w2cbw003-bt \
    kernel-module-tsc2007 \
    kernel-module-twl4030-vibra \
    kernel-module-v4l2-async \
    kernel-module-v4l2-fwnode \
    kernel-module-videobuf2-common \
    kernel-module-videobuf2-dma-contig \
    kernel-module-videobuf2-memops \
    kernel-module-videobuf2-v4l2 \
    kernel-module-videodev \
    kernel-module-wl18xx \
    kernel-module-wlcore \
    kernel-module-wlcore-sdio \
    kernel-module-wwan-on-off \
    linux-firmware-wl18xx \
    linux-firmware-wl1835-bluetooth \
"

# spawn getty on serial console
SERIAL_CONSOLES = "115200;ttyO2"
```
